## build/conf/bblayers.conf
```bitbake
# POKY_BBLAYERS_CONF_VERSION is increased each time build/conf/bblayers.conf
# changes incompatibly
POKY_BBLAYERS_CONF_VERSION = "2"

BBPATH = "${TOPDIR}"
BBFILES ?= ""

BBLAYERS ?= " \
  /home/vlad/poky/meta \
  /home/vlad/poky/meta-poky \
  /home/vlad/poky/meta-yocto-bsp \
  /home/vlad/poky/meta-minimal \
  "
```

## meta-minimal/conf/layer.conf
```bitbake
# We have a conf and classes directory, add to BBPATH
BBPATH .= ":${LAYERDIR}"

# We have recipes-* directories, add to BBFILES
BBFILES += "${LAYERDIR}/recipes-*/*/*.bb \
	${LAYERDIR}/recipes-*/*/*.bbappend"

BBFILE_COLLECTIONS += "minimal"
BBFILE_PATTERN_minimal = "^${LAYERDIR}/"
BBFILE_PRIORITY_minimal = "6"
```
